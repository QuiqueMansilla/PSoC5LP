# CY8C3866AXA_040 register map
File version: 0.1
CY8C38
Registers are 8-bit, read-write, no defined reset value unless marked. A register's access mark holds for its fields unless they carry their own. Offsets are from the block's base; lines under a group give offsets from that group; [hi:lo] are bit positions; {n}, {i} and the like mark numbered series; 'fields as' and 'values as' point back to an identical list; <NAME> marks a mode.

## Memory map
0x00006479 LCD_Cntl_Port size 0x1

## LCD_Cntl_Port
Base 0x00006479
0x00 LCD_Cntl_Port_CONTROL_REG
